## CMakeLists.txt
```
#
# Copyright (c) 2018 Nordic Semiconductor
#
# SPDX-License-Identifier: LicenseRef-Nordic-5-Clause
#
cmake_minimum_required(VERSION 3.20.0)

find_package(Zephyr REQUIRED HINTS $ENV{ZEPHYR_BASE})
project(ADC)

# NORDIC SDK APP START
target_sources(app PRIVATE
  src/main.c
  src/accs.c
  src/adc.c
)

# NORDIC SDK APP END
zephyr_library_include_directories(.)
```

## prj.conf
```kconfig
#
# Copyright (c) 2018 Nordic Semiconductor
#
# SPDX-License-Identifier: LicenseRef-Nordic-5-Clause
#

# Logger module
CONFIG_LOG=y

# Button and LED library
CONFIG_DK_LIBRARY=y

# Bluetooth LE
CONFIG_BT=y
CONFIG_BT_PERIPHERAL=y
CONFIG_BT_DEVICE_NAME="menneen_pyyhkija"

# Increase stack size for the main thread and System Workqueue
CONFIG_SYSTEM_WORKQUEUE_STACK_SIZE=2048
CONFIG_MAIN_STACK_SIZE=2048

CONFIG_ADC=y
```

## src/main.c
```c
/*
 * Copyright (c) 2023 Nordic Semiconductor ASA
 *
 * SPDX-License-Identifier: LicenseRef-Nordic-5-Clause
 */

#include <zephyr/kernel.h>
#include <zephyr/logging/log.h>
#include <zephyr/bluetooth/bluetooth.h>
#include <zephyr/bluetooth/gap.h>
#include <zephyr/bluetooth/uuid.h>
#include <zephyr/bluetooth/conn.h>
#include <dk_buttons_and_leds.h>
#include "accs.h"
#include "adc.h"
#include <zephyr/device.h>
#include <zephyr/devicetree.h>

static struct bt_le_adv_param *adv_param = BT_LE_ADV_PARAM(
	(BT_LE_ADV_OPT_CONNECTABLE |
	 BT_LE_ADV_OPT_USE_IDENTITY), /* Connectable advertising and use identity address */
	800, /* Min Advertising Interval 500ms (800*0.625ms) */
	801, /* Max Advertising Interval 500.625ms (801*0.625ms) */
	NULL); /* Set to NULL for undirected advertising */

LOG_MODULE_REGISTER(Lesson4_Exercise2, LOG_LEVEL_INF);

#define DEVICE_NAME CONFIG_BT_DEVICE_NAME
#define DEVICE_NAME_LEN (sizeof(DEVICE_NAME) - 1)

#define RUN_STATUS_LED DK_LED1
#define CON_STATUS_LED DK_LED2
#define USER_LED DK_LED3
#define USER_BUTTON DK_BTN1_MSK

#define STACKSIZE 1024
#define PRIORITY 7

#define RUN_LED_BLINK_INTERVAL 1000
#define NOTIFY_INTERVAL 3000

static const struct bt_data ad[] = {
	BT_DATA_BYTES(BT_DATA_FLAGS, (BT_LE_AD_GENERAL | BT_LE_AD_NO_BREDR)),
	BT_DATA(BT_DATA_NAME_COMPLETE, DEVICE_NAME, DEVICE_NAME_LEN),

};

static const struct bt_data sd[] = {
	BT_DATA_BYTES(BT_DATA_UUID128_ALL, BT_UUID_ACCS_VAL),
};

void send_data_thread(void)
{
	while (1) {
		get_measurements();

		k_sleep(K_MSEC(NOTIFY_INTERVAL));
	}
}

// A yellow squiggly arrives without the "has_changed"
static void button_pressed(uint32_t button_state, uint32_t has_changed)
{
	if (button_state & USER_BUTTON) {
		set_orientation();
	}
	return;
}

static void on_connected(struct bt_conn *conn, uint8_t err)
{
	if (err) {
		printk("Connection failed (err %u)\n", err);
		return;
	}

	printk("Connected\n");

	dk_set_led_on(CON_STATUS_LED);
}

static void on_disconnected(struct bt_conn *conn, uint8_t reason)
{
	printk("Disconnected (reason %u)\n", reason);

	dk_set_led_off(CON_STATUS_LED);
}

struct bt_conn_cb connection_callbacks = {
	.connected = on_connected,
	.disconnected = on_disconnected,
};

static int init_button(void)
{
	int err;

	err = dk_buttons_init(button_pressed);
	if (err) {
		printk("Cannot init buttons (err: %d)\n", err);
	}

	return err;
}

int main(void)
{
	int blink_status = 0;
	int err;

	if (initializeADC() != 0)
	{
		printk("ADC initialization failed!");
		return -1;
	}

	LOG_INF("Starting Lesson 4 - Exercise 2 \n");

	err = dk_leds_init();
	if (err) {
		LOG_ERR("LEDs init failed (err %d)\n", err);
		return -1;
	}

	err = init_button();
	if (err) {
		printk("Button init failed (err %d)\n", err);
		return -1;
	}

	err = bt_enable(NULL);
	if (err) {
		LOG_ERR("Bluetooth init failed (err %d)\n", err);
		return -1;
	}
	bt_conn_cb_register(&connection_callbacks);

	LOG_INF("Bluetooth initialized\n");
	err = bt_le_adv_start(adv_param, ad, ARRAY_SIZE(ad), sd, ARRAY_SIZE(sd));
	if (err) {
		LOG_ERR("Advertising failed to start (err %d)\n", err);
		return -1;
	}

	LOG_INF("Advertising successfully started\n");
	for (;;) {
		dk_set_led(RUN_STATUS_LED, (++blink_status) % 2);
		k_sleep(K_MSEC(RUN_LED_BLINK_INTERVAL));
	}
}

/* STEP 18.2 - Define and initialize a thread to send data periodically */
K_THREAD_DEFINE(send_data_thread_id, STACKSIZE, send_data_thread, NULL, NULL, NULL, PRIORITY, 0, 0);
```

## src/accs.c
```c
/*
 * Copyright (c) 2018 Nordic Semiconductor ASA
 *
 * SPDX-License-Identifier: LicenseRef-Nordic-5-Clause
 */

/** @file
 *  @brief LED Button Service (LBS) sample modified for acceleration data
 */

#include <zephyr/types.h>
#include <stddef.h>
#include <string.h>
#include <errno.h>
#include <zephyr/sys/printk.h>
#include <zephyr/sys/byteorder.h>
#include <zephyr/kernel.h>
#include <zephyr/logging/log.h>
#include <zephyr/bluetooth/bluetooth.h>
#include <zephyr/bluetooth/hci.h>
#include <zephyr/bluetooth/conn.h>
#include <zephyr/bluetooth/uuid.h>
#include <zephyr/bluetooth/gatt.h>

#include "accs.h"
#include "adc.h"

//LOG_MODULE_DECLARE(Lesson4_Exercise2);

static bool notify_enabled;
struct Measurement measurements;
uint8_t sensor_orientation = 0;

static void accs_ccc_notify_cfg_changed(const struct bt_gatt_attr *attr, uint16_t value)
{
	notify_enabled = (value == BT_GATT_CCC_NOTIFY);
}

void get_measurements(void)
{
	measurements = readADCValue();
	printk("x = %d, y = %d, z = %d\n", measurements.x, measurements.y, measurements.z);
	printk("Sensorin asento %d\n", sensor_orientation);

	send_sensor_x_notify(measurements.x);
	send_sensor_y_notify(measurements.y);
	send_sensor_z_notify(measurements.z);
	accs_send_sensor_notify(sensor_orientation);
}

void set_orientation(void)
{
	printk("Nappia painettu -> asento vaihtuu\n");
	printk("Asennot:\n");
	printk("0 = X-akseli alas - suuri arvo\n");
	printk("1 = X-akseli ylös - pieni arvo\n");
	printk("2 = Y-akseli alas - suuri arvo\n");
	printk("3 = Y-akseli ylös - pieni arvo\n");
	printk("4 = Z-akseli alas - suuri arvo\n");
	printk("5 = Z-akseli ylös - pieni arvo\n");

	sensor_orientation++;

	if (sensor_orientation > 5) {
		sensor_orientation = 0;
	}
}

BT_GATT_SERVICE_DEFINE(
	acceleration_service, BT_GATT_PRIMARY_SERVICE(BT_UUID_ACCS),

	BT_GATT_CHARACTERISTIC(BT_UUID_X, BT_GATT_CHRC_NOTIFY, BT_GATT_PERM_NONE, NULL, NULL, &measurements.x),
	BT_GATT_CCC(accs_ccc_notify_cfg_changed, BT_GATT_PERM_READ | BT_GATT_PERM_WRITE),
	BT_GATT_CHARACTERISTIC(BT_UUID_Y, BT_GATT_CHRC_NOTIFY, BT_GATT_PERM_NONE, NULL, NULL, &measurements.y),
	BT_GATT_CCC(accs_ccc_notify_cfg_changed, BT_GATT_PERM_READ | BT_GATT_PERM_WRITE),
	BT_GATT_CHARACTERISTIC(BT_UUID_Z, BT_GATT_CHRC_NOTIFY, BT_GATT_PERM_NONE, NULL, NULL, &measurements.z),
	BT_GATT_CCC(accs_ccc_notify_cfg_changed, BT_GATT_PERM_READ | BT_GATT_PERM_WRITE),
	BT_GATT_CHARACTERISTIC(BT_UUID_ORIENTATION, BT_GATT_CHRC_NOTIFY, BT_GATT_PERM_NONE, NULL, NULL, &sensor_orientation),
	BT_GATT_CCC(accs_ccc_notify_cfg_changed, BT_GATT_PERM_READ | BT_GATT_PERM_WRITE),
);

int accs_send_sensor_notify(uint32_t sensor_value)
{
	if (!notify_enabled) {
		return -EACCES;
	}

	return bt_gatt_notify(NULL, bt_gatt_find_by_uuid(NULL, 0, BT_UUID_ORIENTATION), &sensor_value, sizeof(sensor_value));
}

int send_sensor_x_notify(uint32_t sensor_value)
{
	if (!notify_enabled) {
		return -EACCES;
	}

	return bt_gatt_notify(NULL, bt_gatt_find_by_uuid(NULL, 0, BT_UUID_X), &sensor_value, sizeof(sensor_value));
}

int send_sensor_y_notify(uint32_t sensor_value)
{
	if (!notify_enabled) {
		return -EACCES;
	}

	return bt_gatt_notify(NULL, bt_gatt_find_by_uuid(NULL, 0, BT_UUID_Y), &sensor_value, sizeof(sensor_value));
}

int send_sensor_z_notify(uint32_t sensor_value)
{
	if (!notify_enabled) {
		return -EACCES;
	}

	return bt_gatt_notify(NULL, bt_gatt_find_by_uuid(NULL, 0, BT_UUID_Z), &sensor_value, sizeof(sensor_value));
}
```

## src/accs.h
```c
/*
 * Copyright (c) 2018 Nordic Semiconductor ASA
 *
 * SPDX-License-Identifier: LicenseRef-Nordic-5-Clause
 */

/*
    Modified from the Nordic MyLBS sample
*/

#ifndef ACCS_H_
#define ACCS_H_

#ifdef __cplusplus
extern "C" {
#endif

#include <zephyr/types.h>

/** @brief Acceleration service UUID. */
#define BT_UUID_ACCS_VAL BT_UUID_128_ENCODE(0xf50234f0, 0x4833, 0x42b8, 0x8d36, 0x983f06b3ee8e)
#define BT_UUID_X_VAL BT_UUID_128_ENCODE(0xf50234f4, 0x4833, 0x42b8, 0x8d36, 0x983f06b3ee8e)
#define BT_UUID_Y_VAL BT_UUID_128_ENCODE(0xf50234f5, 0x4833, 0x42b8, 0x8d36, 0x983f06b3ee8e)
#define BT_UUID_Z_VAL BT_UUID_128_ENCODE(0xf50234f6, 0x4833, 0x42b8, 0x8d36, 0x983f06b3ee8e)
#define BT_UUID_ORIENTATION_VAL BT_UUID_128_ENCODE(0xf50234f7, 0x4833, 0x42b8, 0x8d36, 0x983f06b3ee8e)

#define BT_UUID_ACCS BT_UUID_DECLARE_128(BT_UUID_ACCS_VAL)
#define BT_UUID_X BT_UUID_DECLARE_128(BT_UUID_X_VAL)
#define BT_UUID_Y BT_UUID_DECLARE_128(BT_UUID_Y_VAL)
#define BT_UUID_Z BT_UUID_DECLARE_128(BT_UUID_Z_VAL)
#define BT_UUID_ORIENTATION BT_UUID_DECLARE_128(BT_UUID_ORIENTATION_VAL)

void get_measurements(void);
void set_orientation(void);

/** @brief Send the sensor value as notification.
 *
 * This function sends an uint32_t  value, typically the value
 * of a simulated sensor to all connected peers.
 *
 * @param[in] sensor_value The value of the simulated sensor.
 *
 * @retval 0 If the operation was successful.
 *           Otherwise, a (negative) error code is returned.
 */
int accs_send_sensor_notify(uint32_t sensor_value);
int send_sensor_x_notify(uint32_t sensor_value);
int send_sensor_y_notify(uint32_t sensor_value);
int send_sensor_z_notify(uint32_t sensor_value);

#ifdef __cplusplus
}
#endif

#endif /* ACCS_H_ */
```

## src/adc.c
```c
#include <zephyr/device.h>
#include <zephyr/devicetree.h>
#include <zephyr/drivers/adc.h>
#include <hal/nrf_saadc.h>
#include <zephyr/kernel.h>
#include <zephyr/sys/printk.h>
#include <zephyr/sys/util.h>
#include <zephyr/sys/printk.h>
#include "adc.h"

#if !DT_NODE_EXISTS(DT_PATH(zephyr_user)) || \
	!DT_NODE_HAS_PROP(DT_PATH(zephyr_user), io_channels)
#error "No suitable devicetree overlay specified"
#endif

#define DT_SPEC_AND_COMMA(node_id, prop, idx) \
	ADC_DT_SPEC_GET_BY_IDX(node_id, idx),

static const struct adc_dt_spec adc_channels[] = {
	DT_FOREACH_PROP_ELEM(DT_PATH(zephyr_user), io_channels,
			     DT_SPEC_AND_COMMA)
};

void printDebugInfo(void)
{
   printk("printing first adc_dt_spec structure contents for all channels\n");
   for(int i = 0;i<3;i++)
   {
   printk("adc_dt_spec structure, channel %d = \n",i);
   printk("Device pointer = %p\n",adc_channels[1].dev);
   printk("Channel Id = %d\n",adc_channels[i].channel_id);
   printk("Voltage reference = %d\n",adc_channels[i].vref_mv);
   printk("Resolution = %d\n",adc_channels[i].resolution);
   printk("Oversampling = %d\n",adc_channels[i].oversampling);
   printk("\n\n");
   }

}

int initializeADC(void)
{
    int err;
	
	for (size_t i = 0U; i < ARRAY_SIZE(adc_channels); i++) {
		if (!device_is_ready(adc_channels[i].dev)) {
			printk("ADC controller device not ready\n");
			return -1;
		}

		err = adc_channel_setup_dt(&adc_channels[i]);
		if (err < 0) {
			printk("Could not setup channel #%d (%d)\n", i, err);
			return -1;
		}
	}

    return 0;
}

struct Measurement readADCValue(void)
{
	int16_t buf;
    struct Measurement m;
    struct adc_sequence sequence = {
	  .buffer = &buf,

	  .buffer_size = sizeof(buf),
    };

    //printk("ADC reading:\n");
	for (size_t i = 0U; i < ARRAY_SIZE(adc_channels); i++) 
    {
		int err;
        int32_t val_mv;
        // For debug use... 
		/*
        printk("- %s, channel %d: ",
		       adc_channels[i].dev->name,
		       adc_channels[i].channel_id);
        */

		(void)adc_sequence_init_dt(&adc_channels[i], &sequence);

		err = adc_read(adc_channels[i].dev, &sequence);
		if (err < 0) {
			printk("Could not read (%d)\n", err);
			continue;
		} else {
            if(i==0)
            {
                m.x = val_mv;
            }
            else if (i==1)
            {
               m.y = val_mv;
            }
            else if (i==2)
            {
                m.z = val_mv;
            }           
			//printk("%"PRId16, buf);
		}

		
		val_mv = buf;
		err = adc_raw_to_millivolts_dt(&adc_channels[i],&val_mv);
		if (err < 0) 
        {
			printk(" (value in mV not available)\n");
		} 
        else 
        {
			if(i==0)
            {
                m.x = val_mv;
            }
            else if (i==1)
            {
               m.y = val_mv;
            }
            else if (i==2)
            {
                m.z = val_mv;
            }           
            //printk(" = %"PRId32" mV\n", val_mv);
		}
	}
    return m;
}
```

## src/adc.h
```c
#ifndef ADC_H_KJJ
#define ADC_H_KJJ

struct Measurement
{
   uint32_t x;
   uint32_t y;
   uint32_t z;
};

int initializeADC(void);
struct Measurement readADCValue(void);
void printDebugInfo(void);


#endif
```

## src/my_lbs.c
```c
/*
 * Copyright (c) 2018 Nordic Semiconductor ASA
 *
 * SPDX-License-Identifier: LicenseRef-Nordic-5-Clause
 */

/** @file
 *  @brief LED Button Service (LBS) sample
 */

#include <zephyr/types.h>
#include <stddef.h>
#include <string.h>
#include <errno.h>
#include <zephyr/sys/printk.h>
#include <zephyr/sys/byteorder.h>
#include <zephyr/kernel.h>
#include <zephyr/logging/log.h>
#include <zephyr/bluetooth/bluetooth.h>
#include <zephyr/bluetooth/hci.h>
#include <zephyr/bluetooth/conn.h>
#include <zephyr/bluetooth/uuid.h>
#include <zephyr/bluetooth/gatt.h>

#include "my_lbs.h"
#include "adc.h"

//LOG_MODULE_DECLARE(Lesson4_Exercise2);

static bool notify_mysensor_enabled;
struct Measurement measurements;
uint8_t sensor_orientation = 0;

static void mylbsbc_ccc_mysensor_cfg_changed(const struct bt_gatt_attr *attr, uint16_t value)
{
	notify_mysensor_enabled = (value == BT_GATT_CCC_NOTIFY);
}

void get_measurements(void)
{
	measurements = readADCValue();
	printk("x = %d, y = %d, z = %d\n", measurements.x, measurements.y, measurements.z);
	printk("Sensorin asento %d\n", sensor_orientation);

	send_sensor_x_notify(measurements.x);
	send_sensor_y_notify(measurements.y);
	send_sensor_z_notify(measurements.z);
	my_lbs_send_sensor_notify(sensor_orientation);
}

void set_orientation(void)
{
	printk("Nappia painettu -> asento vaihtuu\n");
	printk("Asennot:\n");
	printk("0 = X-akseli alas - suuri arvo\n");
	printk("1 = X-akseli ylös - pieni arvo\n");
	printk("2 = Y-akseli alas - suuri arvo\n");
	printk("3 = Y-akseli ylös - pieni arvo\n");
	printk("4 = Z-akseli alas - suuri arvo\n");
	printk("5 = Z-akseli ylös - pieni arvo\n");

	sensor_orientation++;

	if (sensor_orientation > 5) {
		sensor_orientation = 0;
	}
}

BT_GATT_SERVICE_DEFINE(
	my_lbs_svc, BT_GATT_PRIMARY_SERVICE(BT_UUID_LBS),

	BT_GATT_CHARACTERISTIC(BT_UUID_X, BT_GATT_CHRC_NOTIFY, BT_GATT_PERM_NONE, NULL, NULL, &measurements.x),
	BT_GATT_CCC(mylbsbc_ccc_mysensor_cfg_changed, BT_GATT_PERM_READ | BT_GATT_PERM_WRITE),
	BT_GATT_CHARACTERISTIC(BT_UUID_Y, BT_GATT_CHRC_NOTIFY, BT_GATT_PERM_NONE, NULL, NULL, &measurements.y),
	BT_GATT_CCC(mylbsbc_ccc_mysensor_cfg_changed, BT_GATT_PERM_READ | BT_GATT_PERM_WRITE),
	BT_GATT_CHARACTERISTIC(BT_UUID_Z, BT_GATT_CHRC_NOTIFY, BT_GATT_PERM_NONE, NULL, NULL, &measurements.z),
	BT_GATT_CCC(mylbsbc_ccc_mysensor_cfg_changed, BT_GATT_PERM_READ | BT_GATT_PERM_WRITE),
	BT_GATT_CHARACTERISTIC(BT_UUID_LBS_MYSENSOR, BT_GATT_CHRC_NOTIFY, BT_GATT_PERM_NONE, NULL, NULL, &sensor_orientation),
	BT_GATT_CCC(mylbsbc_ccc_mysensor_cfg_changed, BT_GATT_PERM_READ | BT_GATT_PERM_WRITE),
);

int my_lbs_send_sensor_notify(uint32_t sensor_value)
{
	if (!notify_mysensor_enabled) {
		return -EACCES;
	}

	return bt_gatt_notify(NULL, bt_gatt_find_by_uuid(NULL, 0, BT_UUID_LBS_MYSENSOR), &sensor_value, sizeof(sensor_value));
}

int send_sensor_x_notify(uint32_t sensor_value)
{
	if (!notify_mysensor_enabled) {
		return -EACCES;
	}

	return bt_gatt_notify(NULL, bt_gatt_find_by_uuid(NULL, 0, BT_UUID_X), &sensor_value, sizeof(sensor_value));
}

int send_sensor_y_notify(uint32_t sensor_value)
{
	if (!notify_mysensor_enabled) {
		return -EACCES;
	}

	return bt_gatt_notify(NULL, bt_gatt_find_by_uuid(NULL, 0, BT_UUID_Y), &sensor_value, sizeof(sensor_value));
}

int send_sensor_z_notify(uint32_t sensor_value)
{
	if (!notify_mysensor_enabled) {
		return -EACCES;
	}

	return bt_gatt_notify(NULL, bt_gatt_find_by_uuid(NULL, 0, BT_UUID_Z), &sensor_value, sizeof(sensor_value));
}
```

## src/my_lbs.h
```c
/*
 * Copyright (c) 2018 Nordic Semiconductor ASA
 *
 * SPDX-License-Identifier: LicenseRef-Nordic-5-Clause
 */

#ifndef BT_LBS_H_
#define BT_LBS_H_

/**@file
 * @defgroup bt_lbs LED Button Service API
 * @{
 * @brief API for the LED Button Service (LBS).
 */

#ifdef __cplusplus
extern "C" {
#endif

#include <zephyr/types.h>

/** @brief LBS Service UUID. */
#define BT_UUID_LBS_VAL BT_UUID_128_ENCODE(0x00001523, 0x1212, 0xefde, 0x1523, 0x785feabcd123)
#define BT_UUID_LBS_MYSENSOR_VAL BT_UUID_128_ENCODE(0x00001526, 0x1212, 0xefde, 0x1523, 0x785feabcd123)
#define BT_UUID_X_VAL BT_UUID_128_ENCODE(0x00001527, 0x1212, 0xefde, 0x1523, 0x785feabcd123)
#define BT_UUID_Y_VAL BT_UUID_128_ENCODE(0x00001528, 0x1212, 0xefde, 0x1523, 0x785feabcd123)
#define BT_UUID_Z_VAL BT_UUID_128_ENCODE(0x00001529, 0x1212, 0xefde, 0x1523, 0x785feabcd123)
#define BT_UUID_LBS_ORIENTATION_VAL BT_UUID_128_ENCODE(0x00001530, 0x1212, 0xefde, 0x1523, 0x785feabcd123)

#define BT_UUID_LBS BT_UUID_DECLARE_128(BT_UUID_LBS_VAL)
#define BT_UUID_LBS_MYSENSOR BT_UUID_DECLARE_128(BT_UUID_LBS_MYSENSOR_VAL)
#define BT_UUID_X BT_UUID_DECLARE_128(BT_UUID_X_VAL)
#define BT_UUID_Y BT_UUID_DECLARE_128(BT_UUID_Y_VAL)
#define BT_UUID_Z BT_UUID_DECLARE_128(BT_UUID_Z_VAL)


/** @brief Send the sensor value as notification.
 *
 * This function sends an uint32_t  value, typically the value
 * of a simulated sensor to all connected peers.
 *
 * @param[in] sensor_value The value of the simulated sensor.
 *
 * @retval 0 If the operation was successful.
 *           Otherwise, a (negative) error code is returned.
 */
int my_lbs_send_sensor_notify(uint32_t sensor_value);

#ifdef __cplusplus
}
#endif

/**
 * @}
 */

#endif /* BT_LBS_H_ */
```
